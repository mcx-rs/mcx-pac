# MCXA153 register map
Vendor: nxp.com; File version: 1.0
MCXA153VFM,MCXA153VFT,MCXA153VLF,MCXA153VLH
CPU: CM33 r2p0, little endian, no MPU, no FPU, VTOR, 3 interrupt priority bits
Registers are 32-bit, read-write, reset 0x0 unless marked. A register's access mark holds for its fields unless they carry their own. Offsets are from the block's base; lines under a group give offsets from that group; [hi:lo] are bit positions; {n}, {i} and the like mark numbered series; 'fields as' and 'values as' point back to an identical list; <NAME> marks a mode.

## Memory map
0x40001000 INPUTMUX0 size 0x664 — INPUTMUX
0x40002000 I3C0 size 0x1000 — I3C
0x40004000 CTIMER0 size 0x88 — CTIMER
0x40005000 CTIMER1 size 0x88 — CTIMER
0x40006000 CTIMER2 size 0x88 — CTIMER
0x40009000 FREQME0 size 0x10 — FREQME
0x4000B000 UTICK0 size 0x20 — UTICK
0x4000C000 WWDT0 size 0x1C — WWDT
0x40080000 DMA0 size 0x110 — DMA MP
0x40081000 EDMA_0_TCD0 size 0x3040 — DMA TCD
0x40089000 AOI0 size 0x10 — AOI
0x4008A000 CRC0 size 0xC — CRC
0x4008B000 CMC size 0x124
0x4008C000 EIM0 size 0x108 — EIM
0x4008D000 ERM0 size 0x11C — ERM
0x4008E000 MBC0 size 0x1CC — TRDC
0x4008F000 SCG0 size 0x404 — SCG
0x40090000 SPC0 size 0x600 — SPC
0x40091000 MRCC0 size 0x10000 — MRCC
0x40091000 SYSCON size 0x1000
0x40091D00 GLIKEY0 size 0x1000 — GLIKEY
0x40092000 WUU0 size 0x5C — WUU
0x40093000 VBAT0 size 0x7FC — VBAT
0x40094000 FMC0 size 0x24 — NPX
0x40095000 FMU0 size 0x30 — Flash
0x40096000 FMU0TEST size 0x1000 — FlashTest
0x4009A000 LPI2C0 size 0x17C — Low-Power Inter-Integrated Circuit
0x4009C000 LPSPI0 size 0x800 — Low-Power Serial Peripheral Interface
0x4009D000 LPSPI1 size 0x800 — Low-Power Serial Peripheral Interface
0x4009F000 LPUART0 size 0x34 — LPUART
0x400A0000 LPUART1 size 0x34 — LPUART
0x400A1000 LPUART2 size 0x34 — LPUART
0x400A4000 USB0 size 0x15D — USBFS
0x400A7000 QDC0 size 0x54 — Quadrature_Decoder
0x400A9000 FLEXPWM0 size 0x196 — PWM
0x400AB000 LPTMR0 size 0x10 — LPTMR
0x400AD000 OSTIMER0 size 0x20 — OSTIMER
0x400AE000 WAKETIMER0 size 0x10 — WAKEUP_TIMER
0x400AF000 ADC0 size 0xFFC — ADC
0x400B1000 CMP0 size 0x3C — LPCMP
0x400B2000 CMP1 size 0x3C — LPCMP
0x400BC000 PORT0 size 0xC8 — PORT
0x400BD000 PORT1 size 0x100 — PORT
0x400BE000 PORT2 size 0xD8 — PORT
0x400BF000 PORT3 size 0x100 — PORT
0x40100000 CDOG size 0x50
0x40101000 DBGMAILBOX size 0x100 — DBGMB
0x40102000 GPIO0 size 0x124 — GPIO
0x40103000 GPIO1 size 0x124 — GPIO
0x40104000 GPIO2 size 0x124 — GPIO
0x40105000 GPIO3 size 0x124 — GPIO
0xE000E000 SCnSCB size 0x10 — System Control not in System Control Block
0xE000E010 SysTick size 0x10 — M33 Systick module
0xE000E100 NVIC size 0xE04 — Nested Vectored Interrupt Controller
0xE000ED00 SCB size 0x90 — System Control Block
0xE000EDD0 SAU size 0xEC — Security Attribution Unit

## Interrupts
0 Reserved16 (NVIC)
1 CMC (CMC, NVIC)
2 DMA_CH0 (DMA0, NVIC)
3 DMA_CH1 (DMA0, NVIC)
4 DMA_CH2 (DMA0, NVIC)
5 DMA_CH3 (DMA0, NVIC)
6 Reserved22 (NVIC)
7 Reserved23 (NVIC)
8 Reserved24 (NVIC)
9 Reserved25 (NVIC)
10 ERM0_SINGLE_BIT (ERM0, NVIC)
11 ERM0_MULTI_BIT (ERM0, NVIC)
12 FMU0 (FMU0, NVIC)
13 GLIKEY0 (GLIKEY0, NVIC)
14 MBC0 (MBC0, NVIC)
15 SCG0 (SCG0, NVIC)
16 SPC0 (SPC0, NVIC)
17 Reserved33 (NVIC)
18 WUU0 (WUU0, NVIC)
19 Reserved35 (NVIC)
20 Reserved36 (NVIC)
21 Reserved37 (NVIC)
22 Reserved38 (NVIC)
23 Reserved39 (NVIC)
24 I3C0 (I3C0, NVIC)
25 Reserved41 (NVIC)
26 LPI2C0 (LPI2C0, NVIC)
27 Reserved43 (NVIC)
28 LPSPI0 (LPSPI0, NVIC)
29 LPSPI1 (LPSPI1, NVIC)
30 Reserved46 (NVIC)
31 LPUART0 (LPUART0, NVIC)
32 LPUART1 (LPUART1, NVIC)
33 LPUART2 (LPUART2, NVIC)
34 Reserved50 (NVIC)
35 Reserved51 (NVIC)
36 USB0 (USB0, NVIC)
37 Reserved53 (NVIC)
38 CDOG0 (CDOG, NVIC)
39 CTIMER0 (CTIMER0, NVIC)
40 CTIMER1 (CTIMER1, NVIC)
41 CTIMER2 (CTIMER2, NVIC)
42 Reserved58 (NVIC)
43 Reserved59 (NVIC)
44 FLEXPWM0_RELOAD_ERROR (FLEXPWM0, NVIC)
45 FLEXPWM0_FAULT (FLEXPWM0, NVIC)
46 FLEXPWM0_SUBMODULE0 (FLEXPWM0, NVIC)
47 FLEXPWM0_SUBMODULE1 (FLEXPWM0, NVIC)
48 FLEXPWM0_SUBMODULE2 (FLEXPWM0, NVIC)
49 Reserved65 (NVIC)
50 QDC0_COMPARE (QDC0, NVIC)
51 QDC0_HOME (QDC0, NVIC)
52 QDC0_WATCHDOG (QDC0, NVIC)
53 QDC0_INDEX (QDC0, NVIC)
54 FREQME0 (FREQME0, NVIC)
55 LPTMR0 (LPTMR0, NVIC)
56 Reserved72 (NVIC)
57 OS_EVENT (OSTIMER0, NVIC)
58 WAKETIMER0 (WAKETIMER0, NVIC)
59 UTICK0 (UTICK0, NVIC)
60 WWDT0 (WWDT0, NVIC)
61 Reserved77 (NVIC)
62 ADC0 (ADC0, NVIC)
63 Reserved79 (NVIC)
64 CMP0 (CMP0, NVIC)
65 CMP1 (CMP1, NVIC)
66 Reserved82 (NVIC)
67 Reserved83 (NVIC)
68 Reserved84 (NVIC)
69 Reserved85 (NVIC)
70 Reserved86 (NVIC)
71 GPIO0 (GPIO0, NVIC)
72 GPIO1 (GPIO1, NVIC)
73 GPIO2 (GPIO2, NVIC)
74 GPIO3 (GPIO3, NVIC)
75 Reserved91 (NVIC)
76 Reserved92 (NVIC)
77 Reserved93 (NVIC)
78 Reserved94 (NVIC)
79 Reserved95 (NVIC)

## Licence text in the file
Copyright 2016-2024 NXP SPDX-License-Identifier: BSD-3-Clause
